## drivers/input/touchscreen/mediatek/jdchipset/Kconfig
```kconfig
#
# Novatek NT36xxx touchscreen driver configuration
#

config TOUCHSCREEN_JDCHIPSET
	bool "JDTECH jd9366"
	help
	  Say Y here if you have a Novatek NT36xxx touchscreen connected
	  to your system.

	  If unsure, say N.
```

## drivers/input/touchscreen/mediatek/sitronix_ts/Kconfig
```kconfig
#
# Touchscreen driver configuration
#
config TOUCHSCREEN_SITRONIX_TOUCH
    bool "Sitronix Ts for TOUCHSCREEN"
    depends on I2C
    default y
    help
      Say Y here if you have Sitronix touch panel.
      If unsure, say N.
      
    
```

## drivers/misc/mediatek/sensors-1.0/alsps/ap3220/Kconfig
```kconfig
config MTK_AP3220
	bool "AP3220 for MediaTek package"
	help
	  It support different type sensor
	  in this platform. If this option
	  is set, it will support ambient
	  and light sensor AP3220.
```

## drivers/misc/mediatek/sensors-1.0/alsps/em3071x/Kconfig
```kconfig
config MTK_EM3071X
	bool "EM3071X for MediaTek package"
	default n
	help
	It support different type sensor
	in this platform. If this option
	is set, it will support ambient
	and light sensor EM3071X.
```
