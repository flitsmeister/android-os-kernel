## drivers/input/touchscreen/mediatek/NT36523_SPI/Kconfig
```kconfig
#
# Novatek NT36523 touchscreen driver configuration
#
config TOUCHSCREEN_MTK_NT36523_SPI
	bool "Novatek NT36523 host download SPI driver"
	default y
	help
	  Say Y here if you have a Novatek NT36523 no flash touchscreen connected
	  to your system by SPI bus.

	  If unsure, say N.
```

## drivers/input/touchscreen/mediatek/ft8201_touch/Kconfig
```kconfig
#
# Focaltech Touchscreen driver configuration
#

config TOUCHSCREEN_MTK_FT8201
    bool "Focaltech 8201 Touchscreen"
    depends on I2C
    help
      Say Y here if you have Focaltech touch panel.
      If unsure, say N.
    
```

## drivers/input/touchscreen/mediatek/hynitron/Kconfig
```kconfig
#
# Touchscreen driver configuration
#
config TOUCHSCREEN_HYNITRON_TS
    bool "hynitron Ts for TOUCHSCREEN"
    depends on I2C
    default y
    help
      Say Y here if you have hynitron touch panel.
      If unsure, say N.
      
    
```

## drivers/misc/mediatek/extcon/Kconfig
```kconfig
config EXTCON_MTK_USB
	tristate "MediaTek EXTCON USB Support"
	select EXTCON
	select USB_ROLE_SWITCH
	help
	  Say Y here to enable extcon support for USB cable detection
	  on the Mediatek PMIC.

config MID_CHARGER_OTG_DRVBUS
	bool "mid charge ic support otg enable"
	default n
	help
	  Say Y here to enable charge ic offer power for USB otg.
config MID_US828ZA_TYPEC_OTG_SUPPORT
	bool "mid MID_US828ZA_TYPEC_OTG_SUPPORT support otg enable"
	default n
	help
	  Say Y here to enable charge ic offer power for US828ZA BOARD USB otg with DC+USB func.
```

## drivers/misc/mediatek/sensors-1.0/accelerometer/stk83xx/Kconfig
```kconfig
config MTK_STK83XX
	bool "STK83XX for MediaTek package"
	default n
	help
        If this option is set, it will support stk83xx Accelerometer.
```

## drivers/misc/mediatek/sensors-1.0/alsps/ltr55x/Kconfig
```kconfig
config MTK_LTR55X
	bool "LTR55X for MediaTek package"
	help
	  It support different type sensor
	  in this platform. If this option
	  is set, it will support ambient
	  and light sensor LTR55X.
```

## drivers/misc/mediatek/sensors-1.0/magnetometer/mmc5603nj/Kconfig
```kconfig
config MTK_MMC5603NJ
	bool "mmc5603nj for MediaTek package"
	help
	  This configuration is for enable or disable mmc5603 magnetic sensor.
	  Say Y here if you want to support this sensor.
	  Say N if you not support it.
	  If no sure, say N.
```
